## sdkconfig.defaults
```kconfig
# ESP32-S3
CONFIG_IDF_TARGET="esp32s3"

# ============================================================
# Flash: 16 MB Quad Flash
# ============================================================

CONFIG_ESPTOOLPY_FLASHSIZE_16MB=y
CONFIG_ESPTOOLPY_FLASHMODE_DIO=y
CONFIG_ESPTOOLPY_FLASHFREQ_80M=y

# ============================================================
# PSRAM: 8 MB Octal PSRAM
# ============================================================

CONFIG_SPIRAM=y
CONFIG_SPIRAM_MODE_OCT=y
CONFIG_SPIRAM_SPEED_40M=y

# ============================================================
# Partition Table
# ============================================================

CONFIG_PARTITION_TABLE_CUSTOM=y
CONFIG_PARTITION_TABLE_CUSTOM_FILENAME="partitions.csv"
CONFIG_PARTITION_TABLE_OFFSET=0x8000
```
